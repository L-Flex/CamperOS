## config/Kconfig.projbuild
```kconfig
menu "CamperNode OS"

    config CAMPER_OTA_BASE_FIRMWARE
        bool "OTA base firmware (v0.1.1, no MOSFET :Od)"
        default n
        help
            Build the one-time USB base image: Zigbee OTA client enabled,
            GPIO-Karte :Od (MOSFET) disabled. Flash this once, then OTA to
            the full firmware (0.2.0+) for MOSFET support.

endmenu
```

## sdkconfig.defaults
```kconfig
# CamperNode OS - Default SDK Configuration
CONFIG_IDF_TARGET="esp32c6"

# Flash size (dual OTA partitions need >= 4MB; use 8MB if your board has it)
CONFIG_ESPTOOLPY_FLASHSIZE_4MB=y
CONFIG_ESPTOOLPY_FLASHSIZE="4MB"

# Partition table
CONFIG_PARTITION_TABLE_CUSTOM=y
CONFIG_PARTITION_TABLE_CUSTOM_FILENAME="partitions.csv"
CONFIG_PARTITION_TABLE_FILENAME="partitions.csv"

# FreeRTOS
CONFIG_FREERTOS_HZ=1000

# NVS
CONFIG_NVS_ENCRYPTION=n

# Logging
CONFIG_LOG_DEFAULT_LEVEL_INFO=y
CONFIG_LOG_MAXIMUM_LEVEL_VERBOSE=y

# OTA rollback (Phase 7)
CONFIG_BOOTLOADER_APP_ROLLBACK_ENABLE=y

# Watchdog
CONFIG_ESP_TASK_WDT_EN=y
CONFIG_ESP_TASK_WDT_TIMEOUT_S=10

# Main task
CONFIG_ESP_MAIN_TASK_STACK_SIZE=4096

# Zigbee End Device (ESP-Zigbee-SDK)
CONFIG_ZB_ENABLED=y
CONFIG_ZB_ZED=y
CONFIG_ZB_RADIO_NATIVE=y
```

## sdkconfig.defaults.ota-base
```kconfig
# OTA base: flash once via USB, then OTA to full firmware (0.2.0+ with MOSFET :Od).
# Usage: copy to sdkconfig.defaults before first build, or menuconfig → CamperNode OS.
CONFIG_CAMPER_OTA_BASE_FIRMWARE=y
```
